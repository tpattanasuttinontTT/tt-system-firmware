## tests/drivers/dma/all_chan_loop_transfer/Kconfig
```kconfig
# Copyright (c) 2026 Tenstorrent AI ULC
# SPDX-License-Identifier: Apache-2.0

mainmenu "DMA Loop Transfer Test"

source "Kconfig.zephyr"

config DMA_LOOP_TRANSFER_RELOCATE_SECTION
	string "the section to place the memory buffers."
	depends on CODE_DATA_RELOCATION
	default "RAM"

config DMA_LOOP_TRANSFER_NUMBER_OF_DMAS
	int "Number of DMAs to test"
	default 1

config DMA_LOOP_TRANSFER_SIZE
	int "Number of bytes to transfer"
	default 8192
```

## tests/drivers/dma/all_chan_scatter_gather/Kconfig
```kconfig
# Copyright (c) 2022 Intel Corporation
# SPDX-License-Identifier: Apache-2.0

mainmenu "DMA Scatter Gather Test"

source "Kconfig.zephyr"

config DMA_NUM_CHANNELS
	int "Number of DMA channels to test"
	default 16

config DMA_SG_XFER_SIZE
	int "Number of bytes to transfer"
	default 128

config DMA_SG_ALIGNMENT
	int "TX and RX data alignment in bytes"
	default 32
	
config DMA_SG_CHANNEL_NR
	int "DMA channel to use"
	default 0

config DMA_NUM_TEST_CHAN
	int "Number of DMA channels to test per controller"
	default 16
	help
	  Number of channels to exercise per DMA controller. The test acquires
	  this many channels up front (via dma_request_channel(), falling back to
	  CONFIG_DMA_SG_CHANNEL_NR + index) and runs the scatter-gather transfer
	  on each channel sequentially.
```
