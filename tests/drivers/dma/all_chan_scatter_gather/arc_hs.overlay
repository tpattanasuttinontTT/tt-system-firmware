/*
 * Copyright (c) 2025 Tenstorrent AI ULC
 * SPDX-License-Identifier: Apache-2.0
 */

tst_dma0: &dma0 {
	status = "okay";
};

/* Increase CSM for scatter_gather test buffers */
&csm {
	reg = <0x10000000 0x40000>; /* 256KB */
};

&vuart0 {
	tx-cap = <16384>;   /* up from 3036; bump until the drops stop */
};